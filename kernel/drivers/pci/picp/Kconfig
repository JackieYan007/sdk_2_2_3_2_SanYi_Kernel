## kernel/drivers/pci/picp/Kconfig
```kconfig
menu "BST PICP"

config BST_PICP
	tristate "PCIE Interconnection Control Protocol Support"
	depends on PCIE_BST

source "drivers/pci/picp/pcie_save_conf/Kconfig"

endmenu
```

## kernel/drivers/pci/picp/pcie_save_conf/Kconfig
```kconfig
config BST_PSC
	bool "PCIE Save Config Support"
    depends on PCIE_BST && MTD_SPI_NOR
```

## kernel/drivers/perf/bst/Kconfig
```kconfig
config BST_PMU
	tristate "BST SoC PMU"
	depends on ARCH_BST
	help
	  Support for BSTA1000 SoC performance monitoring

config BST_DDR_PRESS_TEST
	tristate "BST DDR PRESS TEST support"
	depends on ARCH_BST
	help
	  To compile this driver as a module, choose M here: the module
	  will be called bst_ddr_press_test.
```

## kernel/drivers/pinctrl/bst/Kconfig
```kconfig
if (ARCH_BST || COMPILE_TEST)

config PINCTRL_MSM
	bool
	select PINMUX
	select PINCONF
	select GENERIC_PINCONF

config PINCTRL_A1000
	tristate "Bst A1000 pin controller driver"
	depends on GPIOLIB && OF
	select PINCTRL_MSM
	help
	This is the pinctrl, pinmux, pinconf driver for the
	Bst iomux block found in the Bst A1000 platform.
	
config BST_PINCTRL_A1000A
        tristate "bst pinctrl a1000a"
	help
        This is the pinctrl, pinmux, pinconf driver for the
	iomux block found in the BST A1000 platform.
          
config BST_PINCTRL_A1000B
        tristate "bst pinctrl a1000b"
	help
        This is the pinctrl, pinmux, pinconf driver for the
	iomux block found in the BST A1000B platform.

endif
```

## kernel/drivers/pwm/bst/Kconfig
```kconfig
config PWM_BST
	tristate "BST PWM support"
	depends on ARCH_BST
	help
	  To compile this driver as a module, choose M here: the module
	  will be called pwm-bst.
```

## kernel/drivers/reset/bst/Kconfig
```kconfig
config RESET_BSTA1000A
	tristate "BST A1000A System Resource Reset"
	help
	  This option enables support for the external reset functions for BST A1000A.
config RESET_BSTA1000B
	tristate "BST A1000B System Resource Reset"
	help
	  This option enables support for the external reset functions for BST A1000B.
```

## kernel/drivers/soc/bst/a1000/Kconfig
```kconfig
				
config BST_DDR_ECC_INT
        tristate "BST DDR ECC interrupt support"
	depends on ARCH_BST
	default n
	help
          To compile this driver as a module, choose M here: the module
          will be called bst_ddr_ecc_int.

config BST_KERNEL_NETLINK
	tristate "BST safety netlink driver support"
	depends on ARCH_BST && NET_DEVLINK
	help
	  This is essentially kernel send message to user for safety function.

source "drivers/soc/bst/a1000/dump_module/Kconfig"
 
```

## kernel/drivers/soc/bst/a1000/dump_module/Kconfig
```kconfig
				
config BST_DUMP_REGISTER
        tristate "bst dump register"
		depends on BST_DWMAC_ETH 
	help
          To compile this driver as dump_register.
       
		
```

## kernel/drivers/spi/bst/Kconfig
```kconfig
config SPI_BST
	tristate "DesignWare SPI controller core support"
	help
	  general driver for SPI controller core from BST

config QSPI_BST
	tristate "BST QSPI controller core support"
	help
	  general driver for QSPI controller core from BST

config QSPI_BST_MMIO
	tristate "Memory-mapped io interface driver for BST QSPI core"
	depends on QSPI_BST


config SPI_BST_MMIO
	tristate "Memory-mapped io interface driver for BST SPI core"
	depends on SPI_BST


config QSPI_BST
	tristate "BST QSPI controller core support"
	help
	  general driver for QSPI controller core from BST

config QSPI_BST_MMIO
	tristate "Memory-mapped io interface driver for BST QSPI core"
	depends on QSPI_BST
```

## kernel/drivers/tee/bst_optee/Kconfig
```kconfig
# OP-TEE Trusted Execution Environment Configuration
config BST_OPTEE
	tristate "BST-OP-TEE"
	depends on ARCH_BST
	help
	  This implements the BST-OP-TEE Trusted Execution Environment (TEE)
	  driver.
```

## kernel/drivers/thermal/bst/Kconfig
```kconfig
config BST_THERMAL
	tristate "Thermal sensors on BST SoC"
	depends on ARCH_BST || COMPILE_TEST
	help
	  Enable the BST thermal sensors driver, which supports
	  the primitive temperature sensor embedded in BST A1000 SoCs.
```

## kernel/drivers/usb/bst/Kconfig
```kconfig
# SPDX-License-Identifier: GPL-2.0

config USB_BST_DWC3
	tristate "DesignWare USB3 DRD Core Support"
	depends on (USB || USB_GADGET) && HAS_DMA
	select USB_XHCI_PLATFORM if USB_XHCI_HCD
	select USB_ROLE_SWITCH if USB_BST_DWC3_DUAL_ROLE
	help
	  Say Y or M here if your system has a Dual Role SuperSpeed
	  USB controller based on the DesignWare USB3 IP Core.

	  If you choose to build this driver is a dynamically linked
	  module, the module will be called dwc3.ko.

if USB_BST_DWC3

config USB_BST_DWC3_ULPI
	bool "Register ULPI PHY Interface"
	depends on USB_ULPI_BUS=y || USB_ULPI_BUS=USB_BST_DWC3
	help
	  Select this if you have ULPI type PHY attached to your DWC3
	  controller.

choice
	bool "BST DWC3 Mode Selection"
	default USB_BST_DWC3_DUAL_ROLE if (USB && USB_GADGET)
	default USB_BST_DWC3_HOST if (USB && !USB_GADGET)
	default USB_BST_DWC3_GADGET if (!USB && USB_GADGET)

config USB_BST_DWC3_HOST
	bool "Host only mode"
	depends on USB=y || USB=USB_BST_DWC3
	help
	  Select this when you want to use DWC3 in host mode only,
	  thereby the gadget feature will be regressed.

config USB_BST_DWC3_GADGET
	bool "Gadget only mode"
	depends on USB_GADGET=y || USB_GADGET=USB_BST_DWC3
	help
	  Select this when you want to use DWC3 in gadget mode only,
	  thereby the host feature will be regressed.

config USB_BST_DWC3_DUAL_ROLE
	bool "Dual Role mode"
	depends on ((USB=y || USB=USB_BST_DWC3) && (USB_GADGET=y || USB_GADGET=USB_BST_DWC3))
	depends on (EXTCON=y || EXTCON=USB_BST_DWC3)
	help
	  This is the default mode of working of DWC3 controller where
	  both host and gadget features are enabled.

endchoice

endif
```

## kernel/drivers/video/fbdev/bst/Kconfig
```kconfig
config FB_VIRTUALBST
	tristate "BST Virtual Frame Buffer support (ONLY FOR BST TESTING!)"
	depends on FB
	select FB_SYS_FILLRECT
	select FB_SYS_COPYAREA
	select FB_SYS_IMAGEBLIT
	select FB_SYS_FOPS
	help
	  This is a `virtual' frame buffer device. It operates on a chunk of
	  unswappable kernel memory instead of on the memory of a graphics
	  board. This means you cannot see any output sent to this frame
	  buffer device, while it does consume precious memory. The main use
	  of this frame buffer device is testing and debugging the frame
	  buffer subsystem. Do NOT enable it for normal systems! To protect
	  the innocent, it has to be enabled explicitly at boot time using the
	  kernel option `video=vfb:'.

	  To compile this driver as a module, choose M here: the
	  module will be called vfb. In order to load it, you must use
	  the vfb_enable=1 option.

	  If unsure, say N.
```

## kernel/drivers/video/v5xx/Kconfig
```kconfig
menuconfig MALI_VPU
	tristate "Mali VPU driver"


config MALI_VPU_DEBUG
	depends on MALI_VPU
	bool "Mali VPU driver debug"
	default n


config MALI_VPU_DEVICE_TREE
	depends on MALI_VPU
	bool "Enable driver support for device trees"
	default n


config CONFIG_MALI_VPU_ENABLE_ALOG
	depends on MALI_VPU
	bool "Send kernel space logs to Android logd socket."
	default y


config CONFIG_MALI_VPU_ENABLE_FTRACE
	depends on MALI_VPU
	bool "Send kernel space logs to ftrace."
	default n
	

config CONFIG_MALI_VPU_ENABLE_PRINT_FILE
	depends on MALI_VPU
	bool "Append file and line number to kernel space log messages."
	default y
	

choice
	depends on MALI_VPU
	prompt "Choose power saving mode"
config MALI_VPU_POWER_SAVING_MODE_DVFS
	bool "Use DVFS"
config MALI_VPU_POWER_SAVING_MODE_CLOCK_GATING
	bool "Use HW clock gating"
endchoice 

choice
	depends on MALI_VPU
	prompt "Choose hardware platform"
config MALI_VPU_VEX6
	bool "Versatile Express 6"
config MALI_VPU_VEX7
	bool "Versatile Express 7"
config MALI_VPU_JUNO
	bool "Juno"
endchoice

config MALI_VPU_DISABLE_WATCHDOG
	depends on MALI_VPU
	bool "Disable the watchdog"
	default n
	
source "drivers/video/v5xx/dma_buf_test_exporter/Kconfig"
```

## kernel/drivers/watchdog/bst/Kconfig
```kconfig
config BST_WATCHDOG
	tristate "BST watchdog"
	depends on HAS_IOMEM
	select WATCHDOG_CORE
	help
	  Say Y here if to include support for the BST watchdog 
	  timer found in many chips.
	  To compile this driver as a module, choose M here: the
	  module will be called bst_wdt.

config BST_WATCHDOG_DEBUG
	bool "bst watchdog test"
	depends on BST_WATCHDOG

config BST_AUTOFEED_A55_WATCHDOG
        bool "bst create kthread auto feed a55 watchdog"
        depends on BST_WATCHDOG
```

## kernel/kernel.its
```
/*
 * U-Boot uImage source file with multiple kernels, ramdisks and FDT blobs
 */

/dts-v1/;

/ {
	description = "Various kernels, ramdisks and FDT blobs";
	#address-cells = <1>;

	images {
		kernel {
			description = "Image.gz linux-5.10.59 from Bst A1000";
			data = /incbin/("./build/arch/arm64/boot/Image.gz");
			type = "kernel";
			arch = "arm64";
			os = "linux";
			compression = "gzip";
			load = <0x84000000>;
			entry = <0x84000000>;
			hash-1 {
				algo = "md5";
			};
			hash-2 {
				algo = "sha1";
			};
		};

		fdt-evb {
			description = "bsta1000-evb fdt";
			data = /incbin/("./build/arch/arm64/boot/dts/bst/bsta1000-evb.dtb");
			type = "flat_dt";
			arch = "arm64";
			compression = "none";
			hash-1 {
				algo = "crc32";
			};
		};

		fdt-evbl {
			description = "bsta1000-evbl fdt";
			data = /incbin/("./build/arch/arm64/boot/dts/bst/bsta1000-evbl.dtb");
			type = "flat_dt";
			arch = "arm64";
			compression = "none";
			hash-1 {
				algo = "crc32";
			};
		};


		fdt-fada {
			description = "bsta1000-fada fdt";
			data = /incbin/("./build/arch/arm64/boot/dts/bst/bsta1000-fada.dtb");
			type = "flat_dt";
			arch = "arm64";
			compression = "none";
			hash-1 {
				algo = "crc32";
			};
		};

		fdt-fadb {
			description = "bsta1000-fadb fdt";
			data = /incbin/("./build/arch/arm64/boot/dts/bst/bsta1000-fadb.dtb");
			type = "flat_dt";
			arch = "arm64";
			compression = "none";
			hash-1 {
				algo = "crc32";
			};
		};

		fdt-fad3a {
			description = "bsta1000-fada fdt";
			data = /incbin/("./build/arch/arm64/boot/dts/bst/bsta1000-fad3a.dtb");
			type = "flat_dt";
			arch = "arm64";
			compression = "none";
			hash-1 {
				algo = "crc32";
			};
		};

		fdt-fad3b {
			description = "bsta1000-fadb fdt";
			data = /incbin/("./build/arch/arm64/boot/dts/bst/bsta1000-fad3b.dtb");
			type = "flat_dt";
			arch = "arm64";
			compression = "none";
			hash-1 {
				algo = "crc32";
			};
		};		
		fdt-fadm {
			description = "bsta1000-fadm fdt";
			data = /incbin/("./build/arch/arm64/boot/dts/bst/bsta1000-fadm.dtb");
			type = "flat_dt";
			arch = "arm64";
			compression = "none";
			hash-1 {
				algo = "crc32";
			};
		};

		fdt-fads {
			description = "bsta1000-fads fdt";
			data = /incbin/("./build/arch/arm64/boot/dts/bst/bsta1000-fads.dtb");
			type = "flat_dt";
			arch = "arm64";
			compression = "none";
			hash-1 {
				algo = "crc32";
			};
		};

		fdt-fawa {
			description = "bsta1000-fawa fdt";
			data = /incbin/("./build/arch/arm64/boot/dts/bst/bsta1000-fawa.dtb");
			type = "flat_dt";
			arch = "arm64";
			compression = "none";
			hash-1 {
				algo = "crc32";
			};
		};

		fdt-fawb {
			description = "bsta1000-fawb fdt";
			data = /incbin/("./build/arch/arm64/boot/dts/bst/bsta1000-fawb.dtb");
			type = "flat_dt";
			arch = "arm64";
			compression = "none";
			hash-1 {
				algo = "crc32";
			};
		};

		fdt-ec {
			description = "bsta1000-ec fdt";
			data = /incbin/("./build/arch/arm64/boot/dts/bst/bsta1000-ec.dtb");
			type = "flat_dt";
			arch = "arm64";
			compression = "none";
			hash-1 {
				algo = "crc32";
			};
		};
		
		fdt-ecv3 {
			description = "bsta1000-ecv3 fdt";
			data = /incbin/("./build/arch/arm64/boot/dts/bst/bsta1000-ecv3.dtb");
			type = "flat_dt";
			arch = "arm64";
			compression = "none";
			hash-1 {
				algo = "crc32";
			};
		};

		fdt-pat {
			description = "bsta1000-pat fdt";
			data = /incbin/("./build/arch/arm64/boot/dts/bst/bsta1000-pat.dtb");
			type = "flat_dt";
			arch = "arm64";
			compression = "none";
			hash-1 {
				algo = "crc32";
			};
		};
		
		fdt-ecu {
			description = "bsta1000-ecu fdt";
			data = /incbin/("./build/arch/arm64/boot/dts/bst/bsta1000-ecu.dtb");
			type = "flat_dt";
			arch = "arm64";
			compression = "none";
			hash-1 {
				algo = "crc32";
			};
		};

		fdt-apa {
			description = "bsta1000-apa fdt";
			data = /incbin/("./build/arch/arm64/boot/dts/bst/bsta1000-apa.dtb");
			type = "flat_dt";
			arch = "arm64";
			compression = "none";
			hash-1 {
				algo = "crc32";
			};
		};

		fdt-jac20 {
			description = "bsta1000-jac20 fdt";
			data = /incbin/("./build/arch/arm64/boot/dts/bst/bsta1000-jac20.dtb");
			type = "flat_dt";
			arch = "arm64";
			compression = "none";
			hash-1 {
				algo = "crc32";
			};
		};

		fdt-jac21 {
			description = "bsta1000-jac21 fdt";
			data = /incbin/("./build/arch/arm64/boot/dts/bst/bsta1000-jac21.dtb");
			type = "flat_dt";
			arch = "arm64";
			compression = "none";
			hash-1 {
				algo = "crc32";
			};
		};


	};

	configurations {
		default = "config-evb";

		config-evb {
			description = "bsta1000 evb configuration";
			kernel = "kernel";
			fdt = "fdt-evb";
		};

		config-evbl {
			description = "bsta1000 evbl configuration";
			kernel = "kernel";
			fdt = "fdt-evbl";
		};
		
		config-fada {
			description = "bsta1000 fada configuration";
			kernel = "kernel";
			fdt = "fdt-fada";
		};

		config-fadb {
			description = "bsta1000 fadb configuration";
			kernel = "kernel";
			fdt = "fdt-fadb";
		};

		config-fad3a {
			description = "bsta1000 fadv3a configuration";
			kernel = "kernel";
			fdt = "fdt-fad3a";
		};

		config-fad3b {
			description = "bsta1000 fadv3b configuration";
			kernel = "kernel";
			fdt = "fdt-fad3b";
		};

		config-fadm {
			description = "bsta1000 fadm configuration";
			kernel = "kernel";
			fdt = "fdt-fadm";
		};

		config-fads {
			description = "bsta1000 fads configuration";
			kernel = "kernel";
			fdt = "fdt-fads";
		};

		config-fawa {
			description = "bsta1000 fawa configuration";
			kernel = "kernel";
			fdt = "fdt-fawa";
		};

		config-fawb {
			description = "bsta1000 fawb configuration";
			kernel = "kernel";
			fdt = "fdt-fawb";
		};

		config-ec {
			description = "bsta1000 edage computer configuration";
			kernel = "kernel";
			fdt = "fdt-ec";
		};
		
		config-ecv3 {
			description = "bsta1000 edage computer v3 configuration";
			kernel = "kernel";
			fdt = "fdt-ecv3";
		};

		config-pat {
			description = "bsta1000 pat configuration";
			kernel = "kernel";
			fdt = "fdt-pat";
		};
		
		config-ecu {
			description = "bsta1000 ecu configuration";
			kernel = "kernel";
			fdt = "fdt-ecu";
		};
		
		config-apa {
			description = "bsta1000 apa configuration";
			kernel = "kernel";
			fdt = "fdt-apa";
		};
		
		config-jac20 {
			description = "bsta1000 jac 2.0 configuration";
			kernel = "kernel";
			fdt = "fdt-jac20";
		};

		config-jac21 {
			description = "bsta1000 jac 2.1 configuration";
			kernel = "kernel";
			fdt = "fdt-jac21";
		};
		
	};
};
```
