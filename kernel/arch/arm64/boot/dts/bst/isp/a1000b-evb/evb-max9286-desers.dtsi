/*
   default deser config for evb
   deser0@i2c2 0x28:    max9286
*/

&i2c2 {
    #address-cells = <1>;
    #size-cells = <0>;

    deser0: max9286@28 {
        compatible = "bst,max9286-deser";
        type = "max9286";
        reg = <0x28>;
        i2c-port = <0>;
        csi2-port = <0>;
        lane-speed = <400>;
        regs = <0x41 0x42 0x43 0x44>;
        maxim,fsync-mode = "manual";
        maxim,him = <1>;
        maxim,fsync_period = <3072000>;         /*76.8MHz/25fps*/ 
        maxim,bws = <0>;
        maxim,dbl = <1>;
        maxim,dt = <3>;      /*YUV8*/
        maxim,hsync_invert = <0>;
        maxim,vsync_invert = <1>; 
    };

    deser1: ti960@32 {
        status = "disabled";
    };

    deser2: ti960@34 {
        status = "disabled";
    };
};

#include "../common/deser.dtsi"
