## kernel/drivers/bst_cv/Kconfig
```kconfig
config BST_CV
    tristate "Support BST CV"
    depends on ARM64
    depends on HAS_DMA
    select BST_CV_FW
    help
        BST CV driver is included
    default m

config BST_CV_FW
    bool "BST CV Runtime Firmware"
```

## kernel/drivers/bst_gwarp_scaler/Kconfig
```kconfig
config BST_CV_GWARP_SCALER
    tristate "Support BST CV GWARP SCALER"
    depends on ARM64
    depends on HAS_DMA
    help
        BST CV driver is included
    default y
```

## kernel/drivers/bst_ipc/Kconfig
```kconfig
config BST_IPC
	bool "Support BST IPC"
	depends on ARM64
	select AI_BSTN_FW
	help
	  BST IPC driver is included
	default y

config AI_BSTN_FW
	bool "Ai bstn dsp runtime firmware"

#test
```

## kernel/drivers/bst_lwnn/Kconfig
```kconfig
config BST_LWNN
    tristate "Support BST LWNN"
    depends on ARM64
    depends on HAS_DMA
    select BST_LWNN_FW
    help
        BST LWNN driver is included
    default m

config BST_LWNN_FW
    bool "BST LWNN Runtime Firmware"
```

## kernel/drivers/bstn/Kconfig
```kconfig
config BSTN
    tristate "Support BSTN IP"
    depends on ARM64
    depends on HAS_DMA
    select AI_BSTN_FW
    help
        BSTN Core driver is included
    default m

config AI_BSTN_FW
    bool "Ai bstn dsp runtime firmware"
```

## kernel/drivers/bus/bst/Kconfig
```kconfig
config BST_NOC
	bool "BST NOC Driver"
	default n
	help
	  Support for BST NOC drivers
```

## kernel/drivers/clk/bst/Kconfig
```kconfig
config COMMON_CLK_BSTA1000A
	bool "Clock driver for BST A1000A"
	help
	  This driver supports BST A1000A crystal clock.
config COMMON_CLK_BSTA1000B
	bool "Clock driver for BST A1000B"
	help
	  This driver supports BST A1000B crystal clock.
```

## kernel/drivers/clocksource/bst/Kconfig
```kconfig
config BST_APB_TIMER
	bool "BST APB timer driver" if COMPILE_TEST
	help
	  Enables the support for the bst_apb timer.

config BST_APB_TIMER_OF
	bool "BST APB timer OF driver"
	select BST_APB_TIMER
	select TIMER_OF
```

## kernel/drivers/dma/bst/Kconfig
```kconfig
config BST_AXI_DMAC
	tristate "Black Sesame Team AXI DMA support base on Synopsys DesignWare"
	depends on OF || COMPILE_TEST
	select DMA_ENGINE
	select DMATEST_BST
	select DMA_VIRTUAL_CHANNELS
	help
	  Enable support for Black Sesame Team AXI DMA controller.

config DMATEST_BST
	tristate "DMA Test client for BST"
	depends on !DMATEST
	select DMA_ENGINE_RAID
	help
	  Simple DMA test client. Say N unless you're debugging a
	  DMA Device driver.
```

## kernel/drivers/dynamic_pr_module/Kconfig
```kconfig
config DYNAMIC_PR_TEST
	tristate "DYNAMIC_PR_TEST"
	depends on ARCH_BST
	help
	  This implement is dynamic_test
```

## kernel/drivers/gpu/drm/bst-vsp/Kconfig
```kconfig
menuconfig BST_VOUT
	bool "BST vout support"
	help
	  This flag enables support for DRM vout.

if BST_VOUT
source "drivers/gpu/drm/bst-vsp/vout/Kconfig"
endif
```

## kernel/drivers/gpu/drm/bst-vsp/vout/Kconfig
```kconfig
config BST_VSP
	bool "Support BST VSP"
	depends on DRM
	help
	  BST IPC driver is included
	default y
```

## kernel/drivers/media/platform/bst-a1000/Kconfig
```kconfig
config VIDEO_BST_ISP
	tristate "BST ISP Video Input Driver"
	depends on VIDEO_V4L2 && VIDEO_V4L2_SUBDEV_API && MEDIA_CONTROLLER
	select VIDEOBUF2_CORE
	select V4L2_FWNODE
	select VIDEOBUF2_MEMOPS
	select VIDEOBUF2_DMA_CONTIG
	select BST_COREIP
	help
	  Support for BST Video Input driver.
config VIDEO_BST_CSI
	tristate "BST ISP Video Input Phy Receiver Driver"
	depends on VIDEO_V4L2 && VIDEO_V4L2_SUBDEV_API && OF
	select V4L2_FWNODE
	help
	  Support for BST Video Phy Receiver driver.
```

## kernel/drivers/media/platform/bst-encoder/Kconfig
```kconfig
config VIDEO_BST_ENCODER
    tristate "BST VSP(encoder) driver"
    depends on VIDEO_DEV && VIDEO_V4L2
    depends on ARCH_BST || COMPILE_TEST
    select VIDEOBUF2_DMA_CONTIG
    select V4L2_MEM2MEM_DEV
    default n
    ---help---
      This is a V4L2 driver for Bst VSP encoder hardware.
      It accelerates encoding operations on BST a1000 SoCs.
```

## kernel/drivers/media/platform/bst-gmwarp/Kconfig
```kconfig
config VIDEO_BST_GMWARP
	tristate "BST gmwarp process Unit"
	depends on VIDEO_DEV && VIDEO_V4L2
	depends on ARCH_BST || COMPILE_TEST
	select VIDEOBUF2_DMA_CONTIG
	select V4L2_MEM2MEM_DEV
	default n
	---help---
	  To compile this driver as a module choose m here.
```

## kernel/drivers/mmc/host/bst/Kconfig
```kconfig
config MMC_SDHCI_BST
	tristate "SDHCI OF support for the BST DWC MSHC"
	depends on MMC_SDHCI_PLTFM
	depends on OF
	depends on COMMON_CLK
	help
	  This selects Synopsys DesignWare Cores Mobile Storage Controller
	  support.
	  If you have a controller with this interface, say Y or M here.
	  If unsure, say N.
```

## kernel/drivers/net/can/bst/Kconfig
```kconfig
config BST_CANFD
	tristate "BST CAN FD controller"
	default y
	help
	  Say Y here if you want to use CAN FD controller found on
	  BST SoCs. The driver puts the controller in CAN FD 
	  mode, which can interoperate with CAN2.0 nodes and support
	  dedicated CAN 2.0 mode.

	  To compile this driver as a module, choose M here: the module will
	  be called bst_canfd.

config BST_CANFD_MEM_TEST
	bool "BST CANFD reserved memory test"
	default n
	depends on BST_CANFD
	help
	Test driver useing reserved memory
```

## kernel/drivers/net/ethernet/bst/Kconfig
```kconfig
#
# BST Net device configuration
#

config NET_VENDOR_BST
	bool "BST Net devices"
	default y
	depends on HAS_IOMEM
    select PHYLINK
	help
	  If you have a network (Ethernet) card based on Synopsys Ethernet IP
	  Cores, say Y.

	  Note that the answer to this question doesn't directly affect the
	  kernel: saying N will just cause the configurator to skip all
	  the questions about BST Net cards. If you say Y, you will
	  be asked for your specific card in the following questions.

if NET_VENDOR_BST

source "drivers/net/ethernet/bst/dwmac/Kconfig"
source "drivers/net/ethernet/bst/veth/Kconfig"

endif # NET_VENDOR_BST
```

## kernel/drivers/net/ethernet/bst/dwmac/Kconfig
```kconfig
config BST_DWMAC_ETH
	tristate "bst dwmac 10/100/1000/EQOS Ethernet driver"
	depends on HAS_IOMEM && HAS_DMA
	select MII
	select PHYLIB
	select CRC32
	imply PTP_1588_CLOCK
	select RESET_CONTROLLER
	help
	  This is the driver for the Ethernet IPs built around a
	  Synopsys IP Core.

if BST_DWMAC_ETH

config BST_GMAC_PLATFORM
	tristate "BST_GMAC Platform bus support"
	depends on BST_DWMAC_ETH
	default y
	help
	  This selects the platform specific bus support for the BST GMAC driver.
	  This is the driver used on several SoCs:
	  BST A1000;BST A800.
	  
	  If you have a controller with this interface, say Y or M here.

	  If unsure, say N.

endif
```

## kernel/drivers/net/ethernet/bst/veth/Kconfig
```kconfig
config BST_PCIE_VETH
	tristate "BST_PCIE virtual ethernet support"
    default y
	depends on PCIE_BST && PCIE_BST_PLAT && (PCIE_BST_HOST || PCIE_BST_EP)
	help
	  This is the driver for the PCIE virtual ethernet built around a
	  BlackSesame SOC.
```

## kernel/drivers/panic_chain/Kconfig
```kconfig
config BST_ERROR_NOTIFIER
	bool "open bst error notifier handle"

config BST_ERROR_TEST
	tristate "bst error module"
	depends on BST_ERROR_NOTIFIER
    default m
```

## kernel/drivers/pci/controller/bst/Kconfig
```kconfig
# SPDX-License-Identifier: GPL-2.0

menu "BlackSesame SOC PCIe Core Support"
	depends on PCI && ARCH_BST

config PCIE_BST
	tristate

config PCIE_BST_PLAT
	tristate
	select PCIE_BST

config PCIE_BST_HOST
	tristate "BlackSesame SOC PCIe controller Host Mode"
	depends on PCI_MSI_IRQ_DOMAIN
	select PCIE_BST
	select PCIE_BST_PLAT
	help
	  Say Y here if you want to support the BST-SOC PCIe controller
	  in Host mode.

config PCIE_BST_EP
	tristate "BlackSesame SOC PCIe controller Endpoint Mode"
	depends on PCI_ENDPOINT
	select PCIE_BST
	select PCIE_BST_PLAT
	select PCI_EPDMA
	help
	  Say Y here if you want to support the BST-SOC PCIe controller
	  in EndPoint mode.

endmenu
```
